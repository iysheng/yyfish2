## arch/arm/mach-stm32/stm32f7/Kconfig
```kconfig
if STM32F7

config TARGET_STM32F746_DISCO
	bool "STM32F746 Discovery board"

config TARGET_STM32F767_YYFISH
	bool "STM32F767 YYFISH board"

source "board/st/stm32f746-disco/Kconfig"

endif
```
